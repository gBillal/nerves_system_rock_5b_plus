## Config.in
```kconfig
# Add project-specific packages for Buildroot here
#
# If these are non-proprietary, please consider contributing them back to
# Nerves or Buildroot.

source "$NERVES_DEFCONFIG_DIR/packages/rtw89/Config.in"
source "$NERVES_DEFCONFIG_DIR/packages/rkmpp/Config.in"
```

## packages/rga/Config.in
```kconfig
config BR2_PACKAGE_RGA
    bool "RGA"
    help
        Rockchip RGA (Raster Graphic Acceleration Unit)

        Source: https://github.com/airockchip/librga
```

## packages/rkmpp/Config.in
```kconfig
config BR2_PACKAGE_RKMPP
    bool "rk-mpp Rockchip Media Processing Platform"
    help
        Rockchip Media Processing Platform (RKMPP).

        Source: https://github.com/rockchip-linux/mpp
```

## packages/rtw89/Config.in
```kconfig
config BR2_PACKAGE_RTW89
    bool "rtw89 WiFi driver for RTL8852BE"
    depends on BR2_LINUX_KERNEL              # needs a kernel
    help
      Out-of-tree Realtek RTL8852BE PCIe WiFi driver.

      Source: https://github.com/a5a5aa555oo/rtw89
```
